## conf/distro/pelux.conf
```bitbake
#
#   Copyright (C) 2017 Pelagicore AB
#   Copyright (C) 2018-2019 Luxoft Sweden AB
#   SPDX-License-Identifier: MIT
#

require conf/distro/poky.conf
require git_describe_version.inc

GIT_DESCRIBE_REPO_DIR := "${@os.path.abspath(os.path.join(d.getVar('COREBASE'), '../../.repo/manifests'))}"

MAINTAINER = "Gordan Markuš <gordan.markus@pelagicore.com>"
DISTRO = "pelux"
DISTRO_NAME = "PELUX"
DISTRO_VERSION := "${@git_describe_version(d.getVar('GIT_DESCRIBE_REPO_DIR'), default='master')}"
TARGET_VENDOR = "-pelux"

# Add distro features
DISTRO_FEATURES_append = " \
    bluez5 \
    multiarch \
    opengl \
    pam \
    process-containment \
    ptest \
    virtualization \
    wayland \
    webengine\
"

# Remove unused poky features
DISTRO_FEATURES_remove = " \
    3g \
    ext2 \
    irda \
    nfc \
    nfs \
    x11 \
    zeroconf \
"

# Enable systemd
DISTRO_FEATURES_append = " systemd"
DISTRO_FEATURES_BACKFILL_CONSIDERED += "sysvinit"
VIRTUAL-RUNTIME_init_manager = "systemd"
VIRTUAL-RUNTIME_initscripts = "systemd-compat-units"

# SDK config
SDK_NAME_PREFIX = "${DISTRO}-sdk"
SDK_VENDOR = "-${DISTRO}sdk"
SDKPATH = "/opt/${SDK_NAME_PREFIX}-${SDK_ARCH}/${SDK_VERSION}"
SDK_VERSION = "${DISTRO_VERSION}"
```

## conf/layer.conf
```bitbake
#
#   Copyright (C) 2016-2017 Pelagicore AB
#   Copyright (C) 2019 Luxoft Sweden AB
#   SPDX-License-Identifier: MIT
#

# We have a conf and classes directory, append to BBPATH
BBPATH .= ":${LAYERDIR}"

# We have a recipes directory, add to BBFILES
BBFILES += "${LAYERDIR}/recipes-*/*/*.bb ${LAYERDIR}/recipes-*/*/*.bbappend"

BBFILE_COLLECTIONS += "pelux-layer"
BBFILE_PATTERN_pelux-layer := "^${LAYERDIR}/"

BBFILE_PRIORITY_pelux-layer = "8"

BBFILES_DYNAMIC += " \
    b2qt:${LAYERDIR}/dynamic-layers/b2qt/*/*/*.bb \
    b2qt:${LAYERDIR}/dynamic-layers/b2qt/*/*/*.bbappend \
    intel:${LAYERDIR}/dynamic-layers/intel/*/*/*.bb \
    intel:${LAYERDIR}/dynamic-layers/intel/*/*/*.bbappend \
    raspberrypi:${LAYERDIR}/dynamic-layers/raspberrypi/*/*/*.bb \
    raspberrypi:${LAYERDIR}/dynamic-layers/raspberrypi/*/*/*.bbappend \
    template-layer:${LAYERDIR}/dynamic-layers/template-layer/*/*/*.bb \
    template-layer:${LAYERDIR}/dynamic-layers/template-layer/*/*/*.bbappend \
"

LAYERSERIES_COMPAT_pelux-layer = "sumo thud warrior"

HOSTTOOLS += "bc"
```

## meta-arp-extras/conf/layer.conf
```bitbake
BBPATH .= ":${LAYERDIR}"

# We have a recipes directory, add to BBFILES
BBFILES += "${LAYERDIR}/recipes-*/*/*.bb ${LAYERDIR}/recipes-*/*/*.bbappend"

BBFILE_COLLECTIONS += "pelux-bsp-arp-layer"
BBFILE_PATTERN_pelux-bsp-arp-layer := "^${LAYERDIR}/"

BBFILE_PRIORITY_pelux-bsp-arp-layer = "10"

LAYERSERIES_COMPAT_pelux-bsp-arp-layer = "sumo thud warrior"
```

## meta-rpi-extras/conf/layer.conf
```bitbake
#
#   Copyright (C) 2017 Pelagicore AB
#   Copyright (C) 2018 Luxoft Sweden AB
#
# We have a conf and classes directory, append to BBPATH
BBPATH .= ":${LAYERDIR}"

# We have a recipes directory, add to BBFILES
BBFILES += "${LAYERDIR}/recipes-*/*/*.bb ${LAYERDIR}/recipes-*/*/*.bbappend"

BBFILE_COLLECTIONS += "pelux-bsp-rpi-layer"
BBFILE_PATTERN_pelux-bsp-rpi-layer := "^${LAYERDIR}/"

BBFILE_PRIORITY_pelux-bsp-rpi-layer = "10"

LAYERSERIES_COMPAT_pelux-bsp-rpi-layer = "sumo"
```

## meta-rpi-extras/conf/local.conf.sample
```bitbake
CONF_VERSION = "1"
DL_DIR = "${TOPDIR}/downloads"

MACHINE = "raspberrypi3"
SDKMACHINE = "x86_64"
DISTRO = "pelux"

BB_NUMBER_THREADS ?= "${@oe.utils.cpu_count()}"
PARALLEL_MAKE ?= "-j ${@oe.utils.cpu_count()}"

PACKAGE_CLASSES ?= "package_rpm"

BB_DANGLINGAPPENDS_WARNONLY = "1"
```

## meta-tegra-extras/conf/layer.conf
```bitbake
BBPATH .= ":${LAYERDIR}"

# We have a recipes directory, add to BBFILES
BBFILES += "${LAYERDIR}/recipes-*/*/*.bb \
            ${LAYERDIR}/recipes-*/*/*.bbappend"

BBFILE_COLLECTIONS += "pelux-bsp-tegra-layer"
BBFILE_PATTERN_pelux-bsp-tegra-layer := "^${LAYERDIR}/"

BBFILE_PRIORITY_pelux-bsp-tegra-layer = "6"

LAYERSERIES_COMPAT_pelux-bsp-tegra-layer = "thud warrior"
```

## scripts/lib/wic/canned-wks/mkefidisk-multiboot.wks
```
# short-description: Create an EFI disk image
# long-description: Creates a partitioned EFI disk image that the user
# can directly dd to boot media.

part /boot --source bootimg-efi --sourceparams="loader=grub-efi" --label msdos --active --align 1024 --use-uuid

part / --source rootfs --fstype=ext4 --label platform1 --size 2756 --align 1024 --overhead-factor 1.3 --use-uuid --uuid 4f531a2e-d931-4308-8ccd-d2262b910bad

part / --source rootfs --fstype=ext4 --label platform2 --size 2756 --align 1024 --overhead-factor 1.3 --use-uuid --uuid 12586f0b-38ad-42b8-8340-fe9d08db7139

part swap --size 44 --label swap1 --fstype=swap --use-uuid

part /data --ondisk sda --size 787 --fstype=ext4 --label data --align 1024 --overhead-factor 1.3 --use-uuid

bootloader --configfile cfg --ptable gpt --timeout=5 --append="rootfstype=ext4 console=ttyS0,115200 console=tty0"
```

## scripts/lib/wic/canned-wks/raspberrypi.wks
```
# short-description: Create Raspberry Pi SD card image
# long-description: Creates a partitioned SD card image for use with
# Raspberry Pi. Boot files are located in the first vfat partition.

part /boot --source bootimg-partition --ondisk mmcblk0 --fstype=vfat --label boot --active --align 4096 --size 20
part / --source rootfs --ondisk mmcblk0 --fstype=ext4 --label platform1 --align 4096 --uuid b488d900-9cc0-11e9-8833-cf4cb425a04d
part / --source rootfs --ondisk mmcblk0 --fstype=ext4 --label platform2 --align 4096 --uuid a2d8ad56-9c9e-11e9-afd8-07ffb5f9d79e
```
